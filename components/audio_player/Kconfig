## components/audio_player/Kconfig
```kconfig
menu "Audio playback"

    config AUDIO_PLAYER_ENABLE_MP3
        bool "Enable mp3 decoding."
        default y
        help
            The audio player can play mp3 files using libhelix-mp3.
    config AUDIO_PLAYER_ENABLE_WAV
        bool "Enable wav file playback"
        default y
        help
            Audio player can decode wave files.

    config AUDIO_PLAYER_LOG_LEVEL
        int "Audio Player log level (0 none - 3 highest)"
        default 0
        range 0 3
        help
            Specify the verbosity of Audio Player log output.
endmenu
```

## components/bsp/Kconfig.projbuild
```kconfig
menu "HMI Board Config"

    choice BSP_LCD_BOARD
        prompt "Select BSP board"
        default BSP_BOARD_ESP32_S3_BOX
        config BSP_BOARD_ESP32_S3_BOX
            bool "BSP board esp32_s3_box"
        config BSP_BOARD_ESP32_S3_BOX_Lite
            bool "BSP board esp32_s3_box_lite"
    endchoice

    config BSP_TOUCH_BUTTON
        depends on BSP_BOARD_ESP32_S3_BOX
        bool "Enable esp32_s3_box touch button"
        default y
        help
            Whether to enable the touch button.
endmenu
```

## components/hardware_driver/Kconfig.projbuild
```kconfig
menu "Audio Media HAL"

choice AUDIO_BOARD
    prompt "Audio hardware board"
    default ESP_LYRAT_MINI_V1_1_BOARD
    help
        Select an audio board to use with the ESP-ADF

config ESP_LYRAT_MINI_V1_1_BOARD
    bool "ESP32-Lyrat Mini V1.1"
config ESP32_KORVO_V1_1_BOARD
    bool "ESP32-Korvo V1.1"
config ESP32_S3_KORVO_V1_0_BOARD
    bool "ESP32-S3-Korvo V1.0"
    depends on IDF_TARGET_ESP32S3BETA
config ESP_KORVO_MIX_B_V1_0_BOARD
    bool "ESP_KORVO_MIX_B_V1.0"
    depends on IDF_TARGET_ESP32S3BETA
config ESP_KORVO_MIX_A_V1_0_BOARD
    bool "ESP_KORVO_MIX_A_V1.0"
config ESP32_S3_KORVO_V2_0_BOARD
    bool "ESP32-S3-Korvo V2.0"
    depends on IDF_TARGET_ESP32S3
config ESP_KORVO_MIX_B_V2_0_BOARD
    bool "ESP_KORVO_MIX_B_V2.0"
    depends on IDF_TARGET_ESP32S3
config ESP32_S2_KALUGA_1_V1_2_BOARD
    bool "ESP32-S2-Kaluga-1 v1.2"
config ESP32_S3_KORVO_V3_0_BOARD
    bool "ESP32-S3-Korvo V3.0"
config ESP32_S3_CUBE_V2_0_BOARD
    bool "ESP32-S3-CUBE V2.0"
endchoice

choice MIC_ARRAY_TYPE
    prompt "Mic-array type"
    depends on ESP32_KORVO_V1_1_BOARD || ESP32_S3_KORVO_V1_0_BOARD || ESP_KORVO_MIX_A_V1_0_BOARD || ESP32_S3_KORVO_V2_0_BOARD || ESP_KORVO_MIX_B_V2_0_BOARD || ESP32_S3_KORVO_V3_0_BOARD

config 2_MIC_LINEAR_ARRAY
	bool "2-mic linear array"
config 3_MIC_CIRCULAR_ARRAY
	bool "3-mic circular array"
endchoice

endmenu
```

## examples/chatgpt_demo/factory_nvs/main/Kconfig.projbuild
```kconfig
menu "Example Configuration"

    config ESP_WIFI_SSID
        string "WiFi SSID"
        default "My Network SSID"
        help
            SSID (network name) for the example to connect to.
    config ESP_WIFI_PASSWORD
        string "WiFi Password"
        default "My Password"
        help
            WiFi password (WPA or WPA2) for the example to use.
    config OPENAI_API_KEY
        string "OpenAI Key"
        default "sk-xxxxxxxx"
        help
            OpenAI api key for the example to use.
    config OPENAI_URL
        string "Base URL"
        default "https://api.openai.com/v1/"
        help
            Base URL for OpenAI API

endmenu
```

## examples/chatgpt_demo/main/Kconfig.projbuild
```kconfig
menu "Example Configuration"

    config VOICE_ID
        string "Speaker Id"
        default "qiumum_0gushi"
        help
            speaker id from https://czyt.tech/post/a-free-tts-api/?from_wecom=1
    config VOLUME_LEVEL
        int "volume level"
        default "90"
        range 1 100
        help
            speaker volume
    config MAX_TOKEN
        int "Chat GPT Response Token"
        default 500
        range 1 2048
        help
            Chat GPT response token between 1 - 2048.            
    config ESP_MAXIMUM_RETRY
        int "Maximum retry"
        default 5
        help
            Set the Maximum retry to avoid station reconnecting to the AP unlimited when the AP is really inexistent.

    choice ESP_WIFI_SCAN_AUTH_MODE_THRESHOLD
        prompt "WiFi Scan auth mode threshold"
        default ESP_WIFI_AUTH_OPEN
        help
            The weakest authmode to accept in the scan mode.

        config ESP_WIFI_AUTH_OPEN
            bool "OPEN"
        config ESP_WIFI_AUTH_WEP
            bool "WEP"
        config ESP_WIFI_AUTH_WPA_PSK
            bool "WPA PSK"
        config ESP_WIFI_AUTH_WPA2_PSK
            bool "WPA2 PSK"
        config ESP_WIFI_AUTH_WPA_WPA2_PSK
            bool "WPA/WPA2 PSK"
        config ESP_WIFI_AUTH_WPA3_PSK
            bool "WPA3 PSK"
        config ESP_WIFI_AUTH_WPA2_WPA3_PSK
            bool "WPA2/WPA3 PSK"
        config ESP_WIFI_AUTH_WAPI_PSK
            bool "WAPI PSK"
    endchoice

endmenu
```
