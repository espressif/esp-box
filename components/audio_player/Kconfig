## examples/factory_demo/defconfig
```kconfig
CONFIG_ESPTOOLPY_FLASHMODE_QIO=y
CONFIG_ESPTOOLPY_FLASHSIZE_16MB=y
CONFIG_PARTITION_TABLE_CUSTOM=y
CONFIG_ESP32_S3_CUBE_BOARD=y
CONFIG_SR_MODEL_WN8_QUANT=y
CONFIG_SR_ENGLISH=y
CONFIG_SPEECH_COMMANDS_NUM=32
CONFIG_EN_SPEECH_COMMAND_ID0="R,g,B,o,T"
CONFIG_EN_SPEECH_COMMAND_ID1="K,R,a,s"
CONFIG_EN_SPEECH_COMMAND_ID2="B,a,K"
CONFIG_EN_SPEECH_COMMAND_ID3="h,b,M"
CONFIG_EN_SPEECH_COMMAND_ID4="K,c,N,T,R,b,L, ,P,a,N,c,L"
CONFIG_EN_SPEECH_COMMAND_ID5="L,i,T, ,K,c,N,T,R,b,L"
CONFIG_EN_SPEECH_COMMAND_ID6="M,f,M,k,m, ,g,N,F,k,M,d,s,c,N"
CONFIG_EN_SPEECH_COMMAND_ID7="M,f,M,k,m, ,g,N,F,k,M,d,s,c,N"
CONFIG_EN_SPEECH_COMMAND_ID8="V,n,L,Y,o,M, ,K,c,N,T,R,b,L"
CONFIG_EN_SPEECH_COMMAND_ID9="B,a,K,L,i,T, ,K,c,N,T,R,b,L"
CONFIG_EN_SPEECH_COMMAND_ID10="T,k,N, ,n,N, ,j,c, ,L,i,T"
CONFIG_EN_SPEECH_COMMAND_ID11="T,k,N, ,e,F, ,j,c, ,L,i,T"
CONFIG_EN_SPEECH_COMMAND_ID12="T,k,N, ,R,f,D"
CONFIG_EN_SPEECH_COMMAND_ID13="T,k,N, ,G,R,m,N"
CONFIG_EN_SPEECH_COMMAND_ID14="T,k,N, ,B,L,o"
CONFIG_EN_SPEECH_COMMAND_ID15="T,k,N, ,W,i,T"
CONFIG_EN_SPEECH_COMMAND_ID16="T,k,N, ,M,a,K,S"
CONFIG_EN_SPEECH_COMMAND_ID17=""
CONFIG_EN_SPEECH_COMMAND_ID18=""
CONFIG_EN_SPEECH_COMMAND_ID19=""
CONFIG_EN_SPEECH_COMMAND_ID20=""
CONFIG_EN_SPEECH_COMMAND_ID21=""
CONFIG_EN_SPEECH_COMMAND_ID22=""
CONFIG_EN_SPEECH_COMMAND_ID23=""
CONFIG_EN_SPEECH_COMMAND_ID24=""
CONFIG_EN_SPEECH_COMMAND_ID25=""
CONFIG_EN_SPEECH_COMMAND_ID26=""
CONFIG_EN_SPEECH_COMMAND_ID27=""
CONFIG_EN_SPEECH_COMMAND_ID28=""
CONFIG_EN_SPEECH_COMMAND_ID29=""
CONFIG_EN_SPEECH_COMMAND_ID30=""
CONFIG_EN_SPEECH_COMMAND_ID31=""
CONFIG_ESP32_S3_CUBE_V2_0_BOARD=y
CONFIG_LV_ATTRIBUTE_FAST_MEM_USE_IRAM=y
CONFIG_LV_COLOR_16_SWAP=y
CONFIG_LV_FONT_MONTSERRAT_28=y
CONFIG_ESP32S3_DEFAULT_CPU_FREQ_240=y
CONFIG_ESP32S3_INSTRUCTION_CACHE_32KB=y
CONFIG_ESP32S3_DATA_CACHE_64KB=y
CONFIG_ESP32S3_DATA_CACHE_LINE_64B=y
CONFIG_ESP32S3_SPIRAM_SUPPORT=y
CONFIG_SPIRAM_MODE_OCT=y
CONFIG_SPIRAM_TYPE_ESPPSRAM64=y
CONFIG_SPIRAM_SPEED_80M=y
CONFIG_SPIRAM_MALLOC_ALWAYSINTERNAL=1024
CONFIG_HTTPD_WS_SUPPORT=y
CONFIG_ESP_SYSTEM_PANIC_PRINT_HALT=y
CONFIG_ESP_CONSOLE_USB_SERIAL_JTAG=y
# CONFIG_ESP_TASK_WDT is not set
CONFIG_FATFS_LFN_HEAP=y
CONFIG_FMB_TIMER_PORT_ENABLED=y
CONFIG_SPI_FLASH_USE_LEGACY_IMPL=y
CONFIG_SPIFFS_OBJ_NAME_LEN=64
```

## examples/factory_demo/sdkconfig.defaults
```kconfig
CONFIG_IDF_TARGET="esp32s3"
CONFIG_APP_RETRIEVE_LEN_ELF_SHA=9
CONFIG_ESPTOOLPY_FLASHMODE_QIO=y
CONFIG_ESPTOOLPY_FLASHSIZE_16MB=y
CONFIG_PARTITION_TABLE_CUSTOM=y
CONFIG_EXAMPLE_WIFI_LISTEN_INTERVAL=10
CONFIG_EXAMPLE_POWER_SAVE_MAX_MODEM=y
CONFIG_EXAMPLE_MAX_CPU_FREQ_240=y
CONFIG_EXAMPLE_MIN_CPU_FREQ_40M=y
CONFIG_SR_WN_LOAD_MULIT_WORD=y
CONFIG_SR_WN_WN9_HILEXIN_MULTI=y
CONFIG_SR_WN_WN9_HIESP_MULTI=y
CONFIG_SR_MN_CN_MULTINET6_QUANT=y
CONFIG_SR_MN_EN_MULTINET6_QUANT=y
CONFIG_BT_ENABLED=y
CONFIG_BT_NIMBLE_ENABLED=y
CONFIG_BT_NIMBLE_MEM_ALLOC_MODE_EXTERNAL=y
CONFIG_BT_NIMBLE_MAX_CONNECTIONS=1
# CONFIG_BT_NIMBLE_ROLE_CENTRAL is not set
# CONFIG_BT_NIMBLE_ROLE_OBSERVER is not set
# CONFIG_ESP_ERR_TO_NAME_LOOKUP is not set
CONFIG_ESP_PHY_MAC_BB_PD=y
CONFIG_PM_ENABLE=y
CONFIG_PM_DFS_INIT_AUTO=y
CONFIG_PM_SLP_IRAM_OPT=y
CONFIG_PM_RTOS_IDLE_OPT=y
CONFIG_SPIRAM=y
CONFIG_SPIRAM_MODE_OCT=y
# CONFIG_SPIRAM_ALLOW_STACK_EXTERNAL_MEMORY is not set
CONFIG_SPIRAM_SPEED_80M=y
CONFIG_SPIRAM_MALLOC_ALWAYSINTERNAL=1024
CONFIG_SPIRAM_TRY_ALLOCATE_WIFI_LWIP=y
CONFIG_SPIRAM_MALLOC_RESERVE_INTERNAL=8192
CONFIG_ESP_DEFAULT_CPU_FREQ_MHZ_240=y
CONFIG_ESP32S3_INSTRUCTION_CACHE_32KB=y
CONFIG_ESP32S3_DATA_CACHE_64KB=y
CONFIG_ESP32S3_DATA_CACHE_LINE_64B=y
CONFIG_ESP_SYSTEM_EVENT_TASK_STACK_SIZE=4096
CONFIG_ESP_CONSOLE_USB_SERIAL_JTAG=y
CONFIG_ESP_TASK_WDT_TIMEOUT_S=7
CONFIG_ESP_IPC_TASK_STACK_SIZE=2048
CONFIG_ESP_WIFI_STATIC_RX_BUFFER_NUM=3
CONFIG_ESP_WIFI_DYNAMIC_RX_BUFFER_NUM=4
CONFIG_ESP_WIFI_STATIC_TX_BUFFER_NUM=4
CONFIG_ESP_WIFI_CACHE_TX_BUFFER_NUM=16
CONFIG_ESP_WIFI_TX_BA_WIN=4
CONFIG_ESP_WIFI_RX_BA_WIN=4
CONFIG_ESP_WIFI_AMSDU_TX_ENABLED=y
# CONFIG_ESP_WIFI_IRAM_OPT is not set
# CONFIG_ESP_WIFI_RX_IRAM_OPT is not set
CONFIG_ESP_WIFI_SLP_IRAM_OPT=y
CONFIG_FREERTOS_HZ=1000
CONFIG_FREERTOS_TIMER_TASK_STACK_DEPTH=3120
CONFIG_FREERTOS_VTASKLIST_INCLUDE_COREID=y
CONFIG_FREERTOS_GENERATE_RUN_TIME_STATS=y
CONFIG_FREERTOS_USE_TICKLESS_IDLE=y
CONFIG_FREERTOS_PLACE_FUNCTIONS_INTO_FLASH=y
CONFIG_LWIP_TCPIP_RECVMBOX_SIZE=16
# CONFIG_LWIP_DHCPS is not set
# CONFIG_LWIP_IPV6 is not set
# CONFIG_LWIP_ICMP is not set
CONFIG_MBEDTLS_EXTERNAL_MEM_ALLOC=y
CONFIG_MBEDTLS_DYNAMIC_BUFFER=y
CONFIG_MBEDTLS_DYNAMIC_FREE_CONFIG_DATA=y
CONFIG_MBEDTLS_TLS_CLIENT_ONLY=y
CONFIG_MBEDTLS_HARDWARE_MPI=n
# CONFIG_MQTT_TRANSPORT_WEBSOCKET is not set
CONFIG_NEWLIB_NANO_FORMAT=y
CONFIG_BUTTON_SHORT_PRESS_TIME_MS=100
CONFIG_BUTTON_LONG_PRESS_TIME_MS=5000
CONFIG_ADC_BUTTON_MAX_BUTTON_PER_CHANNEL=4
CONFIG_BSP_LCD_DRAW_BUF_HEIGHT=10
CONFIG_LV_COLOR_16_SWAP=y
CONFIG_LV_MEM_CUSTOM=y
CONFIG_LV_FONT_MONTSERRAT_24=y
CONFIG_LV_FONT_MONTSERRAT_32=y
CONFIG_LV_FONT_FMT_TXT_LARGE=y
# CONFIG_LV_USE_FONT_PLACEHOLDER is not set
CONFIG_LV_USE_FS_POSIX=y
CONFIG_LV_FS_POSIX_LETTER=83
CONFIG_LV_USE_PNG=y
CONFIG_LV_USE_BMP=y
CONFIG_LV_USE_SJPG=y
CONFIG_LV_USE_GIF=y
CONFIG_LV_USE_QRCODE=y

CONFIG_ESP_RMAKER_SELF_CLAIM=y
```

## examples/image_display/sdkconfig.defaults
```kconfig
CONFIG_IDF_TARGET="esp32s3"

CONFIG_ESP_SYSTEM_PANIC_PRINT_HALT=y

CONFIG_ESP_CONSOLE_USB_SERIAL_JTAG=y

CONFIG_ESP32S3_DATA_CACHE_64KB=y
CONFIG_ESP32S3_DATA_CACHE_LINE_64B=y
CONFIG_ESP32S3_INSTRUCTION_CACHE_32KB=y
CONFIG_ESP32S3_SPIRAM_SUPPORT=y

CONFIG_ESPTOOLPY_FLASHMODE_QIO=y
CONFIG_ESPTOOLPY_FLASHSIZE_16MB=y

CONFIG_LV_COLOR_16_SWAP=y
# 83 == 'S'
CONFIG_LV_FS_POSIX_LETTER=83
CONFIG_LV_MEM_CUSTOM=y
CONFIG_LV_USE_BMP=y
CONFIG_LV_USE_FS_POSIX=y
CONFIG_LV_USE_GIF=y
CONFIG_LV_USE_PNG=y
CONFIG_LV_USE_SJPG=y

CONFIG_PARTITION_TABLE_CUSTOM=y

CONFIG_SPIRAM_MODE_OCT=y
CONFIG_SPIRAM_SPEED_80M=y

# BSP
CONFIG_BSP_LCD_DRAW_BUF_HEIGHT=10
```

## examples/lv_demos/sdkconfig.defaults
```kconfig
CONFIG_IDF_TARGET="esp32s3"

CONFIG_ESP_CONSOLE_USB_SERIAL_JTAG=y

CONFIG_ESP_SYSTEM_PANIC_PRINT_HALT=y

CONFIG_ESP32S3_DATA_CACHE_64KB=y
CONFIG_ESP32S3_DATA_CACHE_LINE_64B=y
CONFIG_ESP32S3_INSTRUCTION_CACHE_32KB=y

CONFIG_ESPTOOLPY_FLASHMODE_QIO=y
CONFIG_ESPTOOLPY_FLASHSIZE_16MB=y

CONFIG_LV_COLOR_16_SWAP=y
CONFIG_LV_FONT_MONTSERRAT_12=y
CONFIG_LV_FONT_MONTSERRAT_16=y
CONFIG_LV_MEM_SIZE_KILOBYTES=48
CONFIG_LV_USE_DEMO_WIDGETS=y

# BSP
CONFIG_BSP_LCD_DRAW_BUF_HEIGHT=10
```

## examples/mp3_demo/sdkconfig.defaults
```kconfig
CONFIG_IDF_TARGET="esp32s3"

CONFIG_BOOTLOADER_COMPILER_OPTIMIZATION_PERF=y
CONFIG_BOOTLOADER_LOG_LEVEL_NONE=y
CONFIG_BOOTLOADER_SKIP_VALIDATE_ALWAYS=y

CONFIG_ESP_CONSOLE_USB_SERIAL_JTAG=y
CONFIG_ESP_MAIN_TASK_STACK_SIZE=4096
CONFIG_ESP_SYSTEM_PANIC_PRINT_HALT=y
CONFIG_ESP_TIMER_TASK_STACK_SIZE=4096

CONFIG_ESP32S3_DATA_CACHE_64KB=y
CONFIG_ESP32S3_DATA_CACHE_LINE_64B=y
CONFIG_ESP32S3_DEFAULT_CPU_FREQ_240=y
CONFIG_ESP32S3_INSTRUCTION_CACHE_32KB=y
CONFIG_ESP32S3_SPIRAM_SUPPORT=y

CONFIG_ESPTOOLPY_FLASHMODE_QIO=y
CONFIG_ESPTOOLPY_FLASHSIZE_16MB=y

CONFIG_LV_COLOR_16_SWAP=y
CONFIG_LV_FONT_MONTSERRAT_18=y
CONFIG_LV_FONT_MONTSERRAT_20=y
CONFIG_LV_FONT_MONTSERRAT_22=y
CONFIG_LV_FONT_MONTSERRAT_24=y
CONFIG_LV_FONT_MONTSERRAT_26=y
CONFIG_LV_FONT_MONTSERRAT_28=y
CONFIG_LV_FONT_MONTSERRAT_32=y

CONFIG_PARTITION_TABLE_CUSTOM=y

CONFIG_FREERTOS_HZ=1000

CONFIG_SPIRAM_MALLOC_ALWAYSINTERNAL=4096
CONFIG_SPIRAM_MALLOC_RESERVE_INTERNAL=8192
CONFIG_SPIRAM_MODE_OCT=y
CONFIG_SPIRAM_SPEED_80M=y

CONFIG_SPIFFS_OBJ_NAME_LEN=128

# BSP
CONFIG_BSP_LCD_DRAW_BUF_HEIGHT=10

CONFIG_ESP_CONSOLE_UART_DEFAULT=y

CONFIG_USB_HOST_CONTROL_TRANSFER_MAX_SIZE=2048
CONFIG_USB_HOST_HW_BUFFER_BIAS_PERIODIC_OUT=y
```

## examples/usb_headset/sdkconfig.defaults
```kconfig
CONFIG_IDF_TARGET="esp32s3"

#
# Board Options
#
CONFIG_FREERTOS_HZ=1000
CONFIG_ESP32S3_DEFAULT_CPU_FREQ_240=y
CONFIG_ESP32S3_DEFAULT_CPU_FREQ_MHZ=240

#
# LVGL
#
CONFIG_LV_CONF_SKIP=y
CONFIG_LV_USE_GIF=y
CONFIG_LV_COLOR_16_SWAP=y
CONFIG_LV_MEM_CUSTOM=y

#
#PSRAM
#
CONFIG_ESP32S3_SPIRAM_SUPPORT=y
CONFIG_SPIRAM_SPEED_80M=y
CONFIG_SPIRAM_MODE_OCT=y

#
# Partition Table
#
CONFIG_PARTITION_TABLE_CUSTOM=y
CONFIG_PARTITION_TABLE_CUSTOM_FILENAME="partitions.csv"

#
# Serial flasher config
#
CONFIG_ESPTOOLPY_FLASHSIZE_16MB=y

#
# Data cache
#
CONFIG_ESP32S3_INSTRUCTION_CACHE_32KB=y
CONFIG_ESP32S3_DATA_CACHE_64KB=y
CONFIG_ESP32S3_DATA_CACHE_LINE_64B=y

# BSP
CONFIG_BSP_LCD_DRAW_BUF_HEIGHT=10

#
# USB Device UAC
#
CONFIG_UAC_SPEAKER_CHANNEL_NUM=1
CONFIG_UAC_MIC_CHANNEL_NUM=1
```

## examples/watering_demo/sdkconfig.defaults
```kconfig
CONFIG_IDF_TARGET="esp32s3"
CONFIG_ESPTOOLPY_FLASHMODE_QIO=y
CONFIG_ESPTOOLPY_FLASHSIZE_16MB=y
CONFIG_PARTITION_TABLE_CUSTOM=y
CONFIG_SR_MN_CN_MULTINET5_RECOGNITION_QUANT8=y
CONFIG_CN_SPEECH_COMMAND_ID0=""
CONFIG_CN_SPEECH_COMMAND_ID1=""
CONFIG_CN_SPEECH_COMMAND_ID2=""
CONFIG_CN_SPEECH_COMMAND_ID3=""
CONFIG_CN_SPEECH_COMMAND_ID4=""
CONFIG_CN_SPEECH_COMMAND_ID5=""
CONFIG_CN_SPEECH_COMMAND_ID6=""
CONFIG_CN_SPEECH_COMMAND_ID7=""
CONFIG_CN_SPEECH_COMMAND_ID8=""
CONFIG_CN_SPEECH_COMMAND_ID9=""
CONFIG_CN_SPEECH_COMMAND_ID10=""
CONFIG_CN_SPEECH_COMMAND_ID11=""
CONFIG_CN_SPEECH_COMMAND_ID12=""
CONFIG_CN_SPEECH_COMMAND_ID13=""
CONFIG_CN_SPEECH_COMMAND_ID14=""
CONFIG_CN_SPEECH_COMMAND_ID15=""
CONFIG_CN_SPEECH_COMMAND_ID16=""
CONFIG_CN_SPEECH_COMMAND_ID17=""
CONFIG_CN_SPEECH_COMMAND_ID18=""
CONFIG_CN_SPEECH_COMMAND_ID19=""
CONFIG_LV_FONT_FMT_TXT_LARGE=y
CONFIG_LV_USE_QRCODE=y
CONFIG_LV_MEM_CUSTOM=y
CONFIG_LV_FONT_MONTSERRAT_18=y
CONFIG_LV_FONT_MONTSERRAT_28=y
CONFIG_LV_FONT_MONTSERRAT_36=y
CONFIG_LV_COLOR_16_SWAP=y

CONFIG_ESP32S3_DEFAULT_CPU_FREQ_240=y
CONFIG_ESP32S3_INSTRUCTION_CACHE_32KB=y
CONFIG_ESP32S3_DATA_CACHE_64KB=y
CONFIG_ESP32S3_DATA_CACHE_LINE_64B=y
CONFIG_ESP_SYSTEM_EVENT_TASK_STACK_SIZE=4096
CONFIG_ESP32S3_SPIRAM_SUPPORT=y
CONFIG_SPIRAM_MODE_OCT=y
CONFIG_SPIRAM_SPEED_80M=y
CONFIG_SPIRAM_MALLOC_ALWAYSINTERNAL=1024
CONFIG_SPIRAM_TRY_ALLOCATE_WIFI_LWIP=y
CONFIG_SPIRAM_MALLOC_RESERVE_INTERNAL=8192
# CONFIG_SPIRAM_ALLOW_BSS_SEG_EXTERNAL_MEMORY=y // Note: Enable it after IDF 21790 is merged.
CONFIG_ESP_SYSTEM_PANIC_PRINT_HALT=y
CONFIG_ESP_CONSOLE_USB_SERIAL_JTAG=y
CONFIG_ESP_TIMER_TASK_STACK_SIZE=2048
CONFIG_ESP32_WIFI_STATIC_RX_BUFFER_NUM=3
CONFIG_ESP32_WIFI_DYNAMIC_RX_BUFFER_NUM=4
CONFIG_ESP32_WIFI_STATIC_TX_BUFFER_NUM=4
CONFIG_ESP32_WIFI_CACHE_TX_BUFFER_NUM=16
CONFIG_ESP32_WIFI_TX_BA_WIN=4
CONFIG_ESP32_WIFI_RX_BA_WIN=4
CONFIG_ESP32_WIFI_AMSDU_TX_ENABLED=y
# CONFIG_ESP32_WIFI_IRAM_OPT is not set
# CONFIG_ESP32_WIFI_RX_IRAM_OPT is not set
# CONFIG_ESP32_WIFI_ENABLE_WPA3_SAE is not set
CONFIG_FREERTOS_TIMER_TASK_STACK_DEPTH=3072

# Bluetooth controller
CONFIG_BT_ENABLED=y
CONFIG_BT_NIMBLE_ENABLED=y
CONFIG_BT_NIMBLE_MAX_CONNECTIONS=1
CONFIG_BT_NIMBLE_ROLE_CENTRAL=n
CONFIG_BT_NIMBLE_ROLE_OBSERVER=n
CONFIG_BT_NIMBLE_MEM_ALLOC_MODE_EXTERNAL=y


CONFIG_FREERTOS_VTASKLIST_INCLUDE_COREID=y
CONFIG_FREERTOS_GENERATE_RUN_TIME_STATS=y
CONFIG_LWIP_TCPIP_RECVMBOX_SIZE=16
# CONFIG_LWIP_IPV6 is not set
CONFIG_MBEDTLS_EXTERNAL_MEM_ALLOC=y
CONFIG_BUTTON_SHORT_PRESS_TIME_MS=100
CONFIG_BUTTON_LONG_PRESS_TIME_MS=500
CONFIG_ADC_BUTTON_MAX_BUTTON_PER_CHANNEL=4

# BSP
CONFIG_BSP_LCD_DRAW_BUF_HEIGHT=10

# rainmaker
CONFIG_ESP_RMAKER_ASSISTED_CLAIM=y
```
